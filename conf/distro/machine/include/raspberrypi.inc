## conf/distro/machine/include/raspberrypi.inc
```bitbake
#
# Quince Distribution - Common configuration for Raspberry Pi
#

# References
#
# * Raspberry Pi  Configuration
#     https://www.raspberrypi.com/documentation/computers/configuration.html
#
# * Raspberry Pi  config.txt
#     https://www.raspberrypi.com/documentation/computers/config_txt.html
#
# * Raspberry Pi bootloader/GPU firmware  Device Tree overlays
#     https://github.com/raspberrypi/firmware/blob/master/boot/overlays/README
#
# * Yocto/OE BSP layer for the Raspberry Pi boards  Optional build configuration
#     https://github.com/agherzan/meta-raspberrypi/blob/master/docs/extra-build-config.md

# Have u-boot load kernel image,
RPI_USE_U_BOOT = "1"

# Kernel image type
KERNEL_IMAGETYPE = "Image"

# u-boot command
KERNEL_BOOTCMD = "booti"

# Enable I2C
#   dtparam=i2c1=on
#   dtparam=i2c_arm=on
ENABLE_I2C = "1"

# Enable SPI bus
#   dtparam=spi=on
ENABLE_SPI_BUS = "1"

# Enable UART (Assign Primary UART to GPIO14[TXD] and GPIO15[RXD])
#  enable_uart=${ENABLE_UART}
ENABLE_UART = "1"

# Enable One-Wire Interface
#   dtoverlay=w1-gpio
ENABLE_W1 = "1"
```

## conf/distro/machine/raspberrypi4.conf
```bitbake
#
# Quince Distribution - Configuration for Raspberry Pi 4 Model B (32bit)
#

# References
#
# * Raspberry Pi  Configuration
#     https://www.raspberrypi.com/documentation/computers/configuration.html
#
# * Raspberry Pi  config.txt
#     https://www.raspberrypi.com/documentation/computers/config_txt.html
#
# * Raspberry Pi bootloader/GPU firmware  Device Tree overlays
#     https://github.com/raspberrypi/firmware/blob/master/boot/overlays/README
#
# * Yocto/OE BSP layer for the Raspberry Pi boards  Optional build configuration
#     https://github.com/agherzan/meta-raspberrypi/blob/master/docs/extra-build-config.md

include conf/distro/machine/include/raspberrypi.inc

# Defines a serial console to enable using getty
SERIAL_CONSOLES = "115200;ttyAMA0"

# Holds the value of the console parameter of the kernel command line
KERNEL_CONSOLE = "ttyAMA0"

# Kernel Command-line for serial console
CMDLINE_SERIAL = "console=ttyAMA0,115200 earlycon=pl011,mmio32,0xfe201000"

# The file on the boot partition launched by the bootloader
#SDIMG_KERNELIMAGE = "${@bb.utils.contains('RPI_USE_U_BOOT', '0', 'kernel7l.img', 'u-boot.bin', d)}"
#RPI_EXTRA_CONFIG:append = "${@bb.utils.contains('RPI_USE_U_BOOT', '0', '# Launch Linux Kernel', '# Launch U-Boot', d)}\n"
#RPI_EXTRA_CONFIG:append = "${@bb.utils.contains('RPI_USE_U_BOOT', '0', 'kernel=kernel7l.img', 'kernel=u-boot.bin', d)}\n"

# Disable onboard Bluetooth on Bluetooth-capable Raspberry Pis.
# On Pis prior to Pi 5 this restores UART0/ttyAMA0 over GPIOs 14 & 15.
RPI_EXTRA_CONFIG:append = "# Disable onboard Bluetooth\n"
RPI_EXTRA_CONFIG:append = "dtoverlay=disable-bt\n"

# Disable onboard WLAN on WiFi-capable Raspberry Pis.
RPI_EXTRA_CONFIG:append = "# Disable onboard WLAN\n"
RPI_EXTRA_CONFIG:append = "dtoverlay=disable-wifi\n"

# Disable VC4 Graphics
DISABLE_VC4GRAPHICS = "1"

# Enable the kernel DRM VC4 HDMI/HVS/V3D driver
#   nohdmi: Disable HDMI output
RPI_EXTRA_CONFIG:append = "# Disable HDMI output\n"
RPI_EXTRA_CONFIG:append = "dtoverlay=vc4-kms-v3d-pi4,nohdmi\n"

# The number of bits in the address space
QUINCE_BITS_OF_ADDRESS_SPACE = "32"

# PHRAM address (only valid if QUINCE_PHRAM is 1)
QUINCE_PHRAM_ADDR = "0x10000000"

# PHRAM size (only valid if QUINCE_PHRAM is 1)
QUINCE_PHRAM_SIZE = "0x10000000"

KERNEL_MODULES = " \
    i2c-bcm2708 \
    i2c-dev \
    pwm-bcm2835 \
    raspberrypi-hwmon \
    spi-bcm2835 \
    spidev \
    w1-gpio \
    w1-therm \
"
```

## conf/distro/machine/raspberrypi5.conf
```bitbake
#
# Quince Distribution - Configuration for Raspberry Pi 5 (64bit)
#

# References
#
# * Raspberry Pi  Configuration
#     https://www.raspberrypi.com/documentation/computers/configuration.html
#
# * Raspberry Pi  config.txt
#     https://www.raspberrypi.com/documentation/computers/config_txt.html
#
# * Raspberry Pi bootloader/GPU firmware  Device Tree overlays
#     https://github.com/raspberrypi/firmware/blob/master/boot/overlays/README
#
# * Yocto/OE BSP layer for the Raspberry Pi boards  Optional build configuration
#     https://github.com/agherzan/meta-raspberrypi/blob/master/docs/extra-build-config.md

include conf/distro/machine/include/raspberrypi.inc

# Use Real-Time Clock module
MACHINE_FEATURES += "rtc"

# Defines a serial console to enable using getty
SERIAL_CONSOLES = "115200;ttyAMA10"

# Holds the value of the console parameter of the kernel command line
KERNEL_CONSOLE = "ttyAMA10"

# Kernel Command-line for serial console
CMDLINE_SERIAL = "console=ttyAMA10,115200 earlycon=pl011,0x107d001000,115200n8"

# The file on the boot partition launched by the bootloader
SDIMG_KERNELIMAGE = "${@bb.utils.contains('RPI_USE_U_BOOT', '0', 'kernel_2712.img', 'u-boot.bin', d)}"
RPI_EXTRA_CONFIG:append = "${@bb.utils.contains('RPI_USE_U_BOOT', '0', '# Launch Linux Kernel', '# Launch U-Boot', d)}\n"
RPI_EXTRA_CONFIG:append = "${@bb.utils.contains('RPI_USE_U_BOOT', '0', 'kernel=kernel_2712.img', 'kernel=u-boot.bin', d)}\n"

# Enable RTC backup battery charging (3V @ ML2020)
RPI_EXTRA_CONFIG:append = "# Enable RTC backup battery charging\n"
RPI_EXTRA_CONFIG:append = "dtparam=rtc_bbat_vchg=3000000\n"

# Enables the Pi 5 cooling fan (enabled automatically by the firmware)
RPI_EXTRA_CONFIG:append = "# Enable auto fan control\n"
RPI_EXTRA_CONFIG:append = "dtparam=cooling_fan=on\n"

# Enable UART0 (/dev/ttyAMA0) on pins 8 and 10 of the 40-way header
RPI_EXTRA_CONFIG:append = "# Enable UART0\n"
RPI_EXTRA_CONFIG:append = "dtparam=uart0=on\n"

# Disable onboard Bluetooth on Bluetooth-capable Raspberry Pis.
RPI_EXTRA_CONFIG:append = "# Disable onboard Bluetooth\n"
RPI_EXTRA_CONFIG:append = "dtoverlay=disable-bt\n"

# Disable onboard WLAN on WiFi-capable Raspberry Pis.
RPI_EXTRA_CONFIG:append = "# Disable onboard WLAN\n"
RPI_EXTRA_CONFIG:append = "dtoverlay=disable-wifi\n"

# Disable VC4 Graphics
DISABLE_VC4GRAPHICS = "1"

# Enable the kernel DRM VC4 HDMI/HVS/V3D driver
#   nohdmi: Disable HDMI output
RPI_EXTRA_CONFIG:append = "# Disable HDMI output\n"
RPI_EXTRA_CONFIG:append = "dtoverlay=vc4-kms-v3d-pi5,nohdmi\n"

# The number of bits in the address space
QUINCE_BITS_OF_ADDRESS_SPACE = "64"

# PHRAM address (only valid if QUINCE_PHRAM is 1)
QUINCE_PHRAM_ADDR = "0x10000000"

# PHRAM size (only valid if QUINCE_PHRAM is 1)
QUINCE_PHRAM_SIZE = "0x10000000"

KERNEL_MODULES = " \
    i2c-bcm2708 \
    i2c-dev \
    pwm-bcm2835 \
    pwm-fan \
    raspberrypi-hwmon \
    rp1-adc \
    rp1-cfe \
    spi-bcm2835 \
    spidev \
    w1-gpio \
    w1-therm \
"
```

## conf/layer.conf
```bitbake
# We have a conf and classes directory, append to BBPATH
BBPATH .= ":${LAYERDIR}"

# We have a recipes directory containing .bb and .bbappend files, add to BBFILES
BBFILES += "${LAYERDIR}/recipes*/*/*.bb \
            ${LAYERDIR}/recipes*/*/*.bbappend"

BBFILE_COLLECTIONS += "quince-rpi"
BBFILE_PATTERN_quince-rpi = "^${LAYERDIR}/"
BBFILE_PRIORITY_quince-rpi = "15"

LAYERDEPENDS_quince-rpi = "core"
LAYERSERIES_COMPAT_quince-rpi = "scarthgap"
```
